## firmware/zmk-config/config/boards/shields/fluxpoint_bench/Kconfig.shield
```kconfig
# Fluxpoint Phase 1 bench shield.
# SPDX-License-Identifier: MIT

config SHIELD_FLUXPOINT_BENCH_LEFT
    def_bool $(shields_list_contains,fluxpoint_bench_left)

config SHIELD_FLUXPOINT_BENCH_RIGHT
    def_bool $(shields_list_contains,fluxpoint_bench_right)
```
